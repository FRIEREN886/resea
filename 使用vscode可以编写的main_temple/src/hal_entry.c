#include "hal_data.h"
#include "FSP_UART.h"
#include "BSP_IIC_EEPROM.h"
#include "BSP_WIFI.h"

uint8_t Read_Buffer[DATA_LEN];
uint16_t Read_Length;


    
FSP_CPP_HEADER
void R_BSP_WarmStart(bsp_warm_start_event_t event);
FSP_CPP_FOOTER

/*******************************************************************************************************************//**
 * main() is generated by the RA Configuration editor and is used to generate threads if an RTOS is used.  This function
 * is called by main() when no RTOS is used.
 **********************************************************************************************************************/
void hal_entry(void)
{
    /* TODO: add your own code here */
    FSP_UART_Init();
    BSP_UART6_WIFI_Init();
    Queue_Init(&WIFI_Circular_queue);
    Queue_Init(&Circular_queue);
    BSP_I2C_EEPROM_Init();
    
    TX_PRINTF_FLAG = 1;
    printf("System Init...sb111111\r\n");
    R_BSP_SoftwareDelay(2000, BSP_DELAY_UNITS_MILLISECONDS);
    
//    while(1)
//    {        
//        if(!Queue_isEmpty(&Circular_queue))
//        {
//            TX_PRINTF_FLAG = 1;
//            Read_Length = Queue_HadUse(&Circular_queue);
//            if(Read_Length >= 1)
//            {
//                memset(Read_Buffer,0,DATA_LEN);
//                Queue_Read(&Circular_queue,Read_Buffer,Read_Length);
//                printf("%s\n",Read_Buffer);
//            }
//        }
//        R_BSP_SoftwareDelay(1,BSP_DELAY_UNITS_MILLISECONDS);
////        if(!Queue_isEmpty(&WIFI_Circular_queue))
////        {
////            WIFI_Read_Length = Queue_HadUse(&WIFI_Circular_queue);
////            TX_PRINTF_FLAG = 1;
////            if(WIFI_Read_Length >= 1)
////            {
////                printf("Read_Length = %d:",WIFI_Read_Length);
////                memset(WIFI_Read_Buffer,0,DATA_LEN);
////                Queue_Read(&WIFI_Circular_queue,WIFI_Read_Buffer,WIFI_Read_Length);
////                printf("%s\n",WIFI_Read_Buffer);
////            }
////        }
////        R_BSP_SoftwareDelay(1,BSP_DELAY_UNITS_MILLISECONDS);
//    }
       
        TX_PRINTF_FLAG = 2;
        FSP_WIFI_AT_ConnetMode;
        R_BSP_SoftwareDelay(100,BSP_DELAY_UNITS_MILLISECONDS);
        BSP_WIFI_Recive_Printf();
        
        R_BSP_SoftwareDelay(100,BSP_DELAY_UNITS_MILLISECONDS);
        TX_PRINTF_FLAG = 2;
        FSP_WIFI_AT_SetNetName;
        R_BSP_SoftwareDelay(100,BSP_DELAY_UNITS_MILLISECONDS);
        BSP_WIFI_Recive_Printf();
        
        R_BSP_SoftwareDelay(100,BSP_DELAY_UNITS_MILLISECONDS);
        TX_PRINTF_FLAG = 2;
        FSP_WIFI_AT_SetNetKey;
        R_BSP_SoftwareDelay(100,BSP_DELAY_UNITS_MILLISECONDS);
        BSP_WIFI_Recive_Printf();
        
//        R_BSP_SoftwareDelay(100,BSP_DELAY_UNITS_MILLISECONDS);
//        TX_PRINTF_FLAG = 2;
//        FSP_WIFI_AT_Scan;
//        R_BSP_SoftwareDelay(20000,BSP_DELAY_UNITS_MILLISECONDS);
//        BSP_WIFI_Recive_Printf();
        
        R_BSP_SoftwareDelay(100,BSP_DELAY_UNITS_MILLISECONDS);
        TX_PRINTF_FLAG = 2;
        FSP_WIFI_AT_Connet;
        R_BSP_SoftwareDelay(5000,BSP_DELAY_UNITS_MILLISECONDS);
        BSP_WIFI_Recive_Printf();
        
        R_BSP_SoftwareDelay(100,BSP_DELAY_UNITS_MILLISECONDS);
        TX_PRINTF_FLAG = 2;
        FSP_WIFI_AT_GetLocalNetInfo;
        R_BSP_SoftwareDelay(5000,BSP_DELAY_UNITS_MILLISECONDS);
        BSP_WIFI_Recive_Printf();

    while(1)
    {        
        if(!Queue_isEmpty(&Circular_queue))
        {
            R_BSP_SoftwareDelay(100,BSP_DELAY_UNITS_MILLISECONDS);
            TX_PRINTF_FLAG = 2;
            Read_Length = Queue_HadUse(&Circular_queue);
            if(Read_Length >= 1)
            {
                memset(Read_Buffer,0,DATA_LEN);
                Queue_Read(&Circular_queue,Read_Buffer,Read_Length);
                printf("%s\n",Read_Buffer);
                
            }
        }
        R_BSP_SoftwareDelay(1,BSP_DELAY_UNITS_MILLISECONDS);
    
        if(!Queue_isEmpty(&WIFI_Circular_queue))
        {
            R_BSP_SoftwareDelay(100,BSP_DELAY_UNITS_MILLISECONDS);
            WIFI_Read_Length = Queue_HadUse(&WIFI_Circular_queue);
            TX_PRINTF_FLAG = 1;
            if(WIFI_Read_Length >= 10)
            {
                memset(WIFI_Read_Buffer,0,DATA_LEN);
                Queue_Read(&WIFI_Circular_queue,WIFI_Read_Buffer,WIFI_Read_Length);
                printf("%s\n",WIFI_Read_Buffer);
            }
        }
        R_BSP_SoftwareDelay(1,BSP_DELAY_UNITS_MILLISECONDS);
    }

#if BSP_TZ_SECURE_BUILD
    /* Enter non-secure code */
    R_BSP_NonSecureEnter();
#endif
}

/*******************************************************************************************************************//**
 * This function is called at various points during the startup process.  This implementation uses the event that is
 * called right before main() to set up the pins.
 *
 * @param[in]  event    Where at in the start up process the code is currently at
 **********************************************************************************************************************/
void R_BSP_WarmStart (bsp_warm_start_event_t event)
{
    if (BSP_WARM_START_RESET == event)
    {
#if BSP_FEATURE_FLASH_LP_VERSION != 0

        /* Enable reading from data flash. */
        R_FACI_LP->DFLCTL = 1U;

        /* Would normally have to wait tDSTOP(6us) for data flash recovery. Placing the enable here, before clock and
         * C runtime initialization, should negate the need for a delay since the initialization will typically take more than 6us. */
#endif
    }

    if (BSP_WARM_START_POST_C == event)
    {
        /* C runtime environment and system clocks are setup. */

        /* Configure pins. */
        R_IOPORT_Open(&g_ioport_ctrl, g_ioport.p_cfg);
    }
}

#if BSP_TZ_SECURE_BUILD

BSP_CMSE_NONSECURE_ENTRY void template_nonsecure_callable ();

/* Trustzone Secure Projects require at least one nonsecure callable function in order to build (Remove this if it is not required to build). */
BSP_CMSE_NONSECURE_ENTRY void template_nonsecure_callable ()
{

}
#endif
